## CMakeLists.txt
```
#-------------------------------------------------------------------------------
# Zephyr Example Application
#
# Copyright (c) 2021 Nordic Semiconductor ASA
# SPDX-License-Identifier: Apache-2.0

cmake_minimum_required(VERSION 3.13.1)
find_package(Zephyr REQUIRED HINTS $ENV{ZEPHYR_BASE})

project(app LANGUAGES C)


set(LOCAL_RPMSG_LITE ${CMAKE_CURRENT_SOURCE_DIR}/../lib/rpmsg_lite)
set(RPMSG_LITE ${CMAKE_CURRENT_SOURCE_DIR}/../../rpmsg-lite)

include_directories(BEFORE ${LOCAL_RPMSG_LITE})

set(APP_SOURCES src/main.c src/rsc_table.c src/vsprintf.c 
${RPMSG_LITE}/lib/common/llist.c 
${LOCAL_RPMSG_LITE}/rpmsg_lite.c 
${RPMSG_LITE}/lib/rpmsg_lite/rpmsg_ns.c 
${LOCAL_RPMSG_LITE}/rpmsg_queue.c 
${LOCAL_RPMSG_LITE}/rpmsg_env_zephyr.c 
${LOCAL_RPMSG_LITE}/rpmsg_platform.c 
${LOCAL_RPMSG_LITE}/virtqueue.c 
)

set(APP_SOURCES ${APP_SOURCES} )

target_include_directories(app 
PUBLIC ${LOCAL_RPMSG_LITE} 
PUBLIC ${RPMSG_LITE}/lib/include 
PUBLIC ${RPMSG_LITE}/lib/include/environment/zephyr 
PUBLIC ${RPMSG_LITE}/lib/include/platform/imx8mm_m4 
PUBLIC src)
target_sources(app PRIVATE ${APP_SOURCES})
```

## Kconfig
```
# Copyright (c) 2021 Nordic Semiconductor ASA
# SPDX-License-Identifier: Apache-2.0
#
# This file is the application Kconfig entry point. All application Kconfig
# options can be defined here or included via other application Kconfig files.
# You can browse these options using the west targets menuconfig (terminal) or
# guiconfig (GUI).

menu "Zephyr"
source "Kconfig.zephyr"
endmenu

module = APP
module-str = APP
source "subsys/logging/Kconfig.template.log_config"


# config RPMSG_LITE_RSC_TABLE
# 	bool "coprocessor resource table"
#    depends on OPENAMP_RSC_TABLE
# 	help
# 	  add the resource table in the generated binary. This table is
# 	  compatible with linux remote proc framework and rpmsh-lite library.
```

## prj.conf
```kconfig
# Copyright (c) 2021 Nordic Semiconductor ASA
# SPDX-License-Identifier: Apache-2.0
#
# This file contains selected Kconfig options for the application.

CONFIG_SENSOR=n
CONFIG_LOG_MODE_IMMEDIATE=y
CONFIG_RPMSG_LITE_RSC_TABLE=y
# CONFIG_OPENAMP_RSC_TABLE=y
# CONFIG_OPENAMP=n
```

## boards/teledatics_kimchi.overlay
```dts
/*
 * Copyright (c) 2023 Teledatics, Inc.
 *
 * 
 */
```

## src/main.c
```c
/*
 * Copyright (c) 2021 Nordic Semiconductor ASA
 * SPDX-License-Identifier: Apache-2.0
 */

#include <zephyr/kernel.h>
#include <zephyr/drivers/sensor.h>
#include <app_version.h>
#include <zephyr/logging/log.h>
#include <zephyr/device.h>
#include <virtqueue.h>
#include "rpmsg_lite.h"
#include "rpmsg_queue.h"
#include "rpmsg_ns.h"
#include "rpmsg_config.h"
#include <assert.h>
#include "board.h"
#include "rsc_table.h"


#define SHM_DEVICE_NAME	"shm"

#if !DT_HAS_CHOSEN(zephyr_ipc_shm)
#error "Sample requires definition of shared memory for rpmsg"
#endif

#define VDEV0_VRING_DEVICE_NAME "vring0"
#if !DT_HAS_CHOSEN(zephyr_vring0_shm)
#error "Sample requires definition of vring0 for rpmsg"
#endif

LOG_MODULE_REGISTER(main, CONFIG_APP_LOG_LEVEL);
extern void my_debug_out(const char *fmt,...);
/* #ifdef printk
#undef printk
#endif
#define printk my_debug_out */


/* Constants derived from device tree */
#define SHM_NODE		DT_CHOSEN(zephyr_ipc_shm)
#define SHM_START_ADDR	DT_REG_ADDR(SHM_NODE)
#define SHM_SIZE		DT_REG_SIZE(SHM_NODE)

#define VRING0_NODE		DT_CHOSEN(zephyr_vring0_shm)
#define VRING0_START_ADDR	DT_REG_ADDR(VRING0_NODE)
#define VRING0_SIZE		DT_REG_SIZE(VRING0_NODE)

/*******************************************************************************
 * Definitions
 ******************************************************************************/
// #define RPMSG_LITE_SHMEM_BASE         (VDEV0_VRING_BASE)
#define RPMSG_LITE_SHMEM_BASE         (VRING0_START_ADDR)
#define RPMSG_LITE_LINK_ID            (RL_PLATFORM_IMX8MM_M4_USER_LINK_ID)
#define RPMSG_LITE_NS_ANNOUNCE_STRING "rpmsg-virtual-tty-channel-1"
#define APP_TASK_STACK_SIZE (256)
#ifndef LOCAL_EPT_ADDR
#define LOCAL_EPT_ADDR (30)
#endif

/* Globals */
static char app_buf[512]; /* Each RPMSG buffer can carry less than 512 payload */
static struct rpmsg_lite_instance *volatile my_rpmsg = NULL;
static struct rpmsg_lite_endpoint *volatile my_ept = NULL;
static volatile rpmsg_queue_handle my_queue        = NULL;
#if defined(RL_USE_STATIC_API) && (RL_USE_STATIC_API == 1)
static uint8_t queue_storage[256*sizeof(rpmsg_queue_rx_cb_data_t)];
#endif


#if 0
static void dumpVirtqueue(const char *name, struct virtqueue *vq)
{
#if 0
	// dump rvq to the console
	printk("dump %s to the console.\n", name);
	printk("vq name: %s\n", vq->vq_name);
	printk("vq flags: %d\n", vq->vq_flags);
	printk("vq align: %d\n", vq->vq_alignment);
	printk("vq ring size: %d\n", vq->vq_ring_size);
	printk("vq ring mem: %p\n", vq->vq_ring_mem);
	printk("vq callback_fc: %p\n", vq->callback_fc);
	printk("vq notify_fc: %p\n", vq->notify_fc);
	printk("vq max indirect size: %d\n", vq->vq_max_indirect_size);
	printk("vq indirect mem size: %d\n", vq->vq_indirect_mem_size);

	printk("vq->vq_ring.num: %d\n", vq->vq_ring.num);
	printk("vq->vq_ring.desc: %p\n", vq->vq_ring.desc);
	printk("vq->vq_ring.avail: %p\n", vq->vq_ring.avail);
	printk("vq->vq_ring.used: %p\n", vq->vq_ring.used);
	printk("vq->vq_ring.used->ring[0].id: %d\n", vq->vq_ring.used->ring[0].id);
	printk("vq->vq_ring.used->ring[0].len: %d\n", vq->vq_ring.used->ring[0].len);
#else
	((void)name);
	((void)vq);
#endif
}


static void dump_rpmsg_lite_instance(struct rpmsg_lite_instance *rpmsg)
{
#if 1
	printk("rpmsg addr: %p\n", rpmsg);
	printk("rpmsg_lite_dev->link_state addr: %p\n", &(rpmsg->link_state));
	printk("offset: %d\n", (uint32_t)(&(rpmsg->link_state)) - (uint32_t)rpmsg);

	virtqueue_dump(rpmsg->rvq);
	virtqueue_dump(rpmsg->tvq);
	printk("rl_endpoints: %p\n", rpmsg->rl_endpoints);
	printk("LOCK: %p\n", rpmsg->lock);
	printk("link_state: %u\n", rpmsg->link_state);
	printk("sh_mem_base: %p\n", rpmsg->sh_mem_base);
	printk("sh_mem_remaining: %u\n", rpmsg->sh_mem_remaining);
	printk("sh_mem_total: %u\n", rpmsg->sh_mem_total);
	printk("link_id: %u\n", rpmsg->link_id);
#else
	((void)rpmsg);
#endif
}

#endif

void app_task(void *arg1, void *arg2, void *arg3)
{
    volatile uint32_t remote_addr = 0;
    struct rpmsg_lite_instance *my_rpmsg = NULL;	
#if defined(RL_USE_STATIC_API) && (RL_USE_STATIC_API == 1)
    struct rpmsg_lite_ept_static_context my_ept_context = {0};
    struct rpmsg_lite_instance rpmsg_ctxt = {0};
	rpmsg_static_queue_ctxt queue_ctxt = {0};
#endif	

    void *rx_buf = NULL;
    uint32_t len = 0;
    int32_t result = 0;
    void *tx_buf = NULL;
    uint32_t size = 0;

	((void)arg1);
	((void)arg2);
	((void)arg3);

    /* Print the initial banner */
    printk("\r\nRPMSG String Echo Zephyr RTOS API Demo...\r\nsizeof(struct rpmsg_lite_instance): %d\r\nRPMSG_LITE_SHMEM_BASE: %p\r\n",
	sizeof(struct rpmsg_lite_instance),
	(void *)RPMSG_LITE_SHMEM_BASE);
#if 0
	copyResourceTable();

    /* Print the initial banner */
    printk("\r\nAfter copyResourceTable()\r\nsizeof(struct rpmsg_lite_instance): %d\r\nRPMSG_LITE_SHMEM_BASE: %p\r\n",
	sizeof(struct rpmsg_lite_instance),
	(void *)RPMSG_LITE_SHMEM_BASE);

#endif 

#if defined(RL_USE_STATIC_API) && (RL_USE_STATIC_API == 1)
	my_rpmsg = rpmsg_lite_remote_init((void *)RPMSG_LITE_SHMEM_BASE, RPMSG_LITE_LINK_ID, RL_NO_FLAGS, &rpmsg_ctxt);
#else
	my_rpmsg = rpmsg_lite_remote_init((void *)RPMSG_LITE_SHMEM_BASE, RPMSG_LITE_LINK_ID, RL_NO_FLAGS);
#endif

	if(my_rpmsg == RL_NULL)
	{
		printk("rpmsg_lite_remote_init failed.\n");
		return;
	}

	if(my_rpmsg->rvq == RL_NULL)
	{
		printk("rvq is NULL.\n");
		return;
	}


	if(my_rpmsg->tvq == RL_NULL)
	{
		printk("tvq is NULL.\n");
		return;
	}
	printk("rpmsg_lite_wait_for_link_up. linkstate addr: %p\n", &(my_rpmsg->link_state));
	/* uint32_t test = RL_SUCCESS; */ /* rpmsg_lite_wait_for_link_up(my_rpmsg, RL_BLOCK); */
	uint32_t test = rpmsg_lite_wait_for_link_up(my_rpmsg, RL_BLOCK);
	if(test != RL_SUCCESS)
	{
		printk("rpmsg_lite_wait_for_link_up failed.\n");
		return;
	}


#if defined(RL_USE_STATIC_API) && (RL_USE_STATIC_API == 1)
    my_queue = rpmsg_queue_create(my_rpmsg, queue_storage, &queue_ctxt);
#else
	my_queue = rpmsg_queue_create(my_rpmsg);
#endif

	if(my_queue == RL_NULL)
	{
		printk("rpmsg_queue_create failed.\n");
		return;
	}
#if defined(RL_USE_STATIC_API) && (RL_USE_STATIC_API == 1)
    my_ept   = rpmsg_lite_create_ept(my_rpmsg, LOCAL_EPT_ADDR, rpmsg_queue_rx_cb, my_queue, &my_ept_context);
#else
	my_ept   = rpmsg_lite_create_ept(my_rpmsg, LOCAL_EPT_ADDR, rpmsg_queue_rx_cb, my_queue);
#endif	

	if(my_ept == RL_NULL)
	{
		printk("rpmsg_lite_create_ept failed.\n");
		return;
	}


    int32_t success = rpmsg_ns_announce(my_rpmsg, my_ept, RPMSG_LITE_NS_ANNOUNCE_STRING, RL_NS_CREATE);
	if(RL_SUCCESS != success)
	{
		printk("rpmsg_ns_announce failed.\n");
		return;
	}

    printk("\r\nNameservice sent, ready for incoming messages...\r\n");

    for (;;)
    {
        /* Get RPMsg rx buffer with message */
        result =
            rpmsg_queue_recv_nocopy(my_rpmsg, my_queue, (uint32_t *)&remote_addr, (char **)&rx_buf, &len, RL_BLOCK);
        if (result != 0)
        {
			printk("rpmsg_queue_recv_nocopy failed.\n");
            assert(false);
        }

        /* Copy string from RPMsg rx buffer */
        assert(len < sizeof(app_buf));
        memcpy(app_buf, rx_buf, len);

        /* Release held RPMsg rx buffer */
        result = rpmsg_queue_nocopy_free(my_rpmsg, rx_buf);
        if (result != 0)
        {
			printk("rpmsg_queue_nocopy_free failed.\n");
            assert(false);
        }
		rx_buf = NULL;

        app_buf[len] = 0; /* End string by '\0' */

		if( (len==1) && ((app_buf[0] == 0xa) || (app_buf[0] == 0xd)) )
		{
			app_buf[0] = '\r';
			app_buf[1] = '\n';
			app_buf[2] = '\0';
		}
		else if ((len == 2) && (app_buf[0] == 0xd) && (app_buf[1] == 0xa))
		{
			app_buf[0] = '\r';
			app_buf[1] = '\n';
			app_buf[2] = '\0';
		}
		printk("%s", app_buf);

        /* Get tx buffer from RPMsg */
        tx_buf = rpmsg_lite_alloc_tx_buffer(my_rpmsg, &size, RL_BLOCK);
        assert(tx_buf);
        /* Copy string to RPMsg tx buffer */
        memcpy(tx_buf, app_buf, len);
        /* Echo back received message with nocopy send */
        result = rpmsg_lite_send_nocopy(my_rpmsg, my_ept, remote_addr, tx_buf, len);
        if (result != 0)
        {
			printk("rpmsg_lite_send_nocopy failed.\n");
            assert(false);
        }
    }

}

static struct k_thread thread_rp__client_data;
K_THREAD_STACK_DEFINE(thread_rp__client_stack, APP_TASK_STACK_SIZE);

#define DT_DRV_COMPAT nxp_imx_mu_rev2

static k_tid_t runRpmsgList();

int main(void)
{
	k_tid_t tId = runRpmsgList();
	if(NULL == tId)
	{
		printk("runRpmsgList failed.\n");
		return -1;
	}
	return 0;
}

static k_tid_t runRpmsgList()
{

	return k_thread_create(&thread_rp__client_data, thread_rp__client_stack, APP_TASK_STACK_SIZE,
			(k_thread_entry_t)app_task,
			NULL, NULL, NULL, K_PRIO_COOP(7), 0, K_NO_WAIT);

}
```

## src/rpmsg_config.h
```c
/*
 * Copyright (c) 2014, Mentor Graphics Corporation
 * Copyright (c) 2015 Xilinx, Inc.
 * Copyright (c) 2016 Freescale Semiconductor, Inc.
 * Copyright 2016-2021 NXP
 * All rights reserved.
 *
 * SPDX-License-Identifier: BSD-3-Clause
 */

#ifndef RPMSG_CONFIG_H_
#define RPMSG_CONFIG_H_

/*!
 * @addtogroup config
 * @{
 * @file
 */

//! @name Configuration options
//@{

//! @def RL_MS_PER_INTERVAL
//!
//! Delay in milliseconds used in non-blocking API functions for polling.
//! The default value is 1.
#define RL_MS_PER_INTERVAL (1)

//! @def RL_BUFFER_PAYLOAD_SIZE
//!
//! Size of the buffer payload, it must be equal to (240, 496, 1008, ...)
//! [2^n - 16]. Ensure the same value is defined on both sides of rpmsg
//! communication. The default value is 496U.
#define RL_BUFFER_PAYLOAD_SIZE (496U)

//! @def RL_BUFFER_COUNT
//!
//! Number of the buffers, it must be power of two (2, 4, ...).
//! The default value is 2U.
//! Note this value defines the buffer count for one direction of the rpmsg
//! communication only, i.e. if the default value of 2 is used
//! in rpmsg_config.h files for the master and the remote side, 4 buffers
//! in total are created in the shared memory.
#define RL_BUFFER_COUNT (256U)

//! @def RL_API_HAS_ZEROCOPY
//!
//! Zero-copy API functions enabled/disabled.
//! The default value is 1 (enabled).
#define RL_API_HAS_ZEROCOPY (1)

//! @def RL_USE_STATIC_API
//!
//! Static API functions (no dynamic allocation) enabled/disabled.
//! The default value is 0 (static API disabled).
#define RL_USE_STATIC_API (1)

//! @def RL_CLEAR_USED_BUFFERS
//!
//! Clearing used buffers before returning back to the pool of free buffers
//! enabled/disabled.
//! The default value is 0 (disabled).
#define RL_CLEAR_USED_BUFFERS (0)

//! @def RL_USE_MCMGR_IPC_ISR_HANDLER
//!
//! When enabled IPC interrupts are managed by the Multicore Manager (IPC
//! interrupts router), when disabled RPMsg-Lite manages IPC interrupts
//! by itself.
//! The default value is 0 (no MCMGR IPC ISR handler used).
#define RL_USE_MCMGR_IPC_ISR_HANDLER (0)

//! @def RL_USE_ENVIRONMENT_CONTEXT
//!
//! When enabled the environment layer uses its own context.
//! Added for QNX port mainly, but can be used if required.
//! The default value is 0 (no context, saves some RAM).
#define RL_USE_ENVIRONMENT_CONTEXT (0)

//! @def RL_DEBUG_CHECK_BUFFERS
//!
//! Do not use in RPMsg-Lite to Linux configuration
#define RL_DEBUG_CHECK_BUFFERS (0)
//@}

#endif /* RPMSG_CONFIG_H_ */
```

## src/rsc_table.c
```c
/*
 * Copyright (c) 2014, Mentor Graphics Corporation
 * All rights reserved.
 * Copyright (c) 2015 Xilinx, Inc. All rights reserved.
 * Copyright 2020 NXP.
 * All rights reserved.
 *
 * SPDX-License-Identifier: BSD-3-Clause
 */

/* This file populates resource table for BM remote
 * for use by the Linux Master */

#include <zephyr/kernel.h>
#include "board.h"
#include "rsc_table.h"
#include "rpmsg_lite.h"
#include "platform/imx8mm_m4/rpmsg_platform.h"
#include <string.h>

#define RSC_TABLE_NAME "rsc_table"
#if !DT_HAS_CHOSEN(zephyr_rsc_table)
#error "Sample requires definition of rsc_table for rpmsg"
#endif

#define VDEV0_VRING_DEVICE_NAME "vring0"
#if !DT_HAS_CHOSEN(zephyr_vring0_shm)
#error "Sample requires definition of vring0 for rpmsg"
#endif

/* Constants derived from device tree */
#define RSC_TABLE_NODE		DT_CHOSEN(zephyr_rsc_table)
#define RSC_TABLE_START_ADDR	DT_REG_ADDR(RSC_TABLE_NODE)
#define RSC_TABLE_SIZE		DT_REG_SIZE(RSC_TABLE_NODE)

#define VRING0_NODE		DT_CHOSEN(zephyr_vring0_shm)
#define VRING0_START_ADDR	DT_REG_ADDR(VRING0_NODE)
#define VRING0_SIZE		DT_REG_SIZE(VRING0_NODE)


#define NUM_VRINGS 0x02

/* Place resource table in special ELF section */
#if defined(__ARMCC_VERSION) || defined(__GNUC__)
__attribute__((section(".resource_table")))
#elif defined(__ICCARM__)
#pragma location = ".resource_table"
#else
#error Compiler not supported!
#endif

const struct remote_resource_table resources = {
    /* Version */
    1,

    /* NUmber of table entries */
    NO_RESOURCE_ENTRIES,
    /* reserved fields */
    {
        0,
        0,
    },

    /* Offsets of rsc entries */
    {
        offsetof(struct remote_resource_table, user_vdev),
    },

    /* SRTM virtio device entry */
    {
        RSC_VDEV,
        7,
        0,
        RSC_VDEV_FEATURE_NS,
        0,
        0,
        0,
        NUM_VRINGS,
        {0, 0},
    },

    /* Vring rsc entry - part of vdev rsc entry */
    {VRING0_START_ADDR, VRING_ALIGN, RL_BUFFER_COUNT, 0, 0},
    {VRING0_START_ADDR + VRING0_SIZE, VRING_ALIGN, RL_BUFFER_COUNT, 1, 0},
/*    {VDEV0_VRING_BASE, VRING_ALIGN, RL_BUFFER_COUNT, 0, 0},
    {VDEV0_VRING_BASE + VRING_SIZE, VRING_ALIGN, RL_BUFFER_COUNT, 1, 0}, */
};

void copyResourceTable(void)
{
    /*
     * Resource table should be copied to VDEV0_VRING_BASE + RESOURCE_TABLE_OFFSET.
     * VDEV0_VRING_BASE is temperorily kept for backward compatibility, will be
     * removed in future release
     */
    memcpy((void *)RSC_TABLE_START_ADDR, &resources, sizeof(resources));
/*    memcpy((void *)VDEV0_VRING_BASE, &resources, sizeof(resources));
    memcpy((void *)(VDEV0_VRING_BASE + RESOURCE_TABLE_OFFSET), &resources, sizeof(resources)); */
}
```

## src/vsprintf.c
```c
#define DT_DRV_COMPAT zephyr_memory_debug
#include <zephyr/device.h>
#include <zephyr/sys/cbprintf.h>
#include <zephyr/sys/printk.h>
#include <stdarg.h>


static char *const debug_buffer = (char *)(DT_REG_ADDR(DT_DRV_INST(0)));	// 0x80000000;
/* vsprintf_imp will advance the buffer pointer passed in by an
	arbitrary amount. We're assuming it will not advance more than 64k
	at a time, so we'll reset index when we get within 512KB of the end of the buffer.
*/
static const size_t buffer_size = DT_REG_SIZE(DT_DRV_INST(0)) - 0x80000;	// 0x1000000;	// 16MB - 512KB
static size_t index = 0;

/**
 * @brief my_debug_out Output a formatted printf string to the debug buffer.
 * 
 * @param fmt format string
 * @param ... arguments
 * 
 * @note This function is intended to be used for debugging purposes only.
 * 	 The debug buffer is a memory region that is shared between the
 * 	 Cortex-M4 and Cortex-A53 cores. The Cortex-M4 core is responsible
 * 	 for writing to the debug buffer. The Cortex-A53 cores are responsible
 * 	 for reading from the debug buffer from linux. THis buffer can be read
 * 	 from linux using the /dev/mem device.
 *   We avoid using much stack space by using the shared memory buffer directly.
 *   We also avoid using any system services at all. As a result, this function
 *   can be used during the earliest stages of boot, before the kernel is
 *   fully initialized.
 */

void my_debug_out_v(const char *fmt, va_list a)
{
	char *buffer = debug_buffer + index;
	va_list args;
	va_copy(args, a);
	int count = vsnprintk(buffer, buffer_size - index, fmt, args);
	va_end(args);
	index += count;
	if(index >= buffer_size)
	{
		/* if we happen to get exactly to the end of the buffer
		/ vsnprintk won't add the terminating null character */
		debug_buffer[index] = '\0';
		index = 0;
	}	
}

void my_debug_out(const char *fmt,...)
{
	va_list args;
	va_start(args, fmt);
	my_debug_out_v(fmt, args);
	va_end(args);
#if 0	
	char *buffer = debug_buffer + index;
	va_list args;
	va_start(args, fmt);
	int count = vsnprintk(buffer, buffer_size - index, fmt, args);
	va_end(args);
	index += count;
	if(index >= buffer_size)
	{
		/* if we happen to get exactly to the end of the buffer
		/ vsnprintk won't add the terminating null character */
		debug_buffer[index] = '\0';
		index = 0;
	}
	#endif
}
```
