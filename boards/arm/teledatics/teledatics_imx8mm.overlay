/*
 * Copyright (c) 2023 Teledatics, Inc.
 *
 * 
 */

/delete-node/ &mailbox0;

/{
    soc {
		mailbox0: mailbox@30ab0000 {
			compatible = "nxp,imx-mu-rev2";
			reg = <0x30ab0000 DT_SIZE_K(64)>;
			interrupts = <97 0>;
			rdc = <(RDC_DOMAIN_PERM(A7_DOMAIN_ID,\
					       RDC_DOMAIN_PERM_RW)|\
			       RDC_DOMAIN_PERM(M4_DOMAIN_ID,\
					       RDC_DOMAIN_PERM_RW))>;
			status = "enabled";
		};        
    };
};
