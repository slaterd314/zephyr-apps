/*
 * Copyright (c) 2023, Teledatics, Inc
 * SPDX-License-Identifier: All rights reserved
 *
 *
 * Note: File generated by imx_cfg_utils.py
 * from MIMX8MM-EVK-REV-C.mex
 */

#include <nxp/nxp_imx/mimx8mm6dvtlz-pinctrl.dtsi>

&pinctrl {
	uart4_default: uart4_default {
		group0 {
			pinmux = <&iomuxc_uart4_rxd_uart_rx_uart4_rx>,
				<&iomuxc_uart4_txd_uart_tx_uart4_tx>;
			slew-rate = "fast";
			drive-strength = "40-ohm";
		};
	};

};
