## boards/arm/teledatics/Kconfig.board
```kconfig
# MIMX8MM EVK board

# Copyright (c) 2023, Teledatics, Inc.
# SPDX-License-Identifier: All rights reserved

config BOARD_TELEDATICS_IMX8MM
	bool "Teledatics imx8mm Halo Board"
	depends on SOC_SERIES_IMX8MM_M4
	select SOC_PART_NUMBER_MIMX8MM6DVTLZ
```

## boards/arm/teledatics/Kconfig.defconfig
```kconfig
# Teledatics Kimchi Halo Board

# Copyright (c) 2023, Teledatics, Inc.
# 
# SPDX-License-Identifier: All rights reserved.

if BOARD_TELEDATICS_KIMCHI

config BOARD
	default "teledatics_imx8mm"

if !XIP
config FLASH_SIZE
	default 0
config FLASH_BASE_ADDRESS
	default 0
endif

endif # BOARD_TELEDATICS_KIMCHI
```

## drivers/rpmsg_lite/Kconfig
```kconfig
# Copyright (c) 2023 Teledatics, Inc.
# 

# if RPMSG_LITE_RSC_TABLE
rsource "rpmsg_lite/Kconfig"
# endif # RPMSG_LITE_RSC_TABLE
```

## drivers/rpmsg_lite/rpmsg_lite/Kconfig
```kconfig
# Copyright (c) 2023 Teledatics, Inc.
#

config RPMSG_LITE_RSC_TABLE
	bool "rpmsg lite"
	default y
	help
	  Enable rpmsg lite
```

## west.yml
```yaml
# Copyright (c) 2021 Nordic Semiconductor ASA
# SPDX-License-Identifier: Apache-2.0

manifest:
  self:
    west-commands: scripts/west-commands.yml

  remotes:
    - name: zephyrproject-rtos
      url-base: https://github.com/zephyrproject-rtos
    - name: nxp-mcuxpresso
      url-base: https://github.com/nxp-mcuxpresso

  projects:
    - name: zephyr
      remote: zephyrproject-rtos
      revision: v3.4.0
      import:
        # By using name-allowlist we can clone only the modules that are
        # strictly needed by the application.
        name-allowlist:
          - cmsis      # required by the ARM port
          - hal_nxp   # required by the custom_plank board (Nordic based)
          - libmetal  # required by the nucleo_f302r8 board (STM32 based)
          - open-amp
          - hal_nordic
          - hal_stm32
    - name: rpmsg-lite
      remote: nxp-mcuxpresso
      revision: master
      path: rpmsg-lite
    - name: mcux-sdk-examples
      remote: nxp-mcuxpresso
      revision: main
      path: mcux-sdk-examples
```
